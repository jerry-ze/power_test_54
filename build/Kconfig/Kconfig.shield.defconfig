## build/Kconfig/boards/Kconfig
```kconfig
# Load Zephyr board Kconfig descriptions.
osource "/home/zengzhi/ncs/v2.9.0/zephyr/boards/nordic/nrf54l15dk/Kconfig"
```

## build/power_hw_54l15/Kconfig/Kconfig.shield
```kconfig
osource "/home/zengzhi/workspace/nordic/hw_test/power_hw_54l15/boards/shields/*/Kconfig.shield"
osource "/home/zengzhi/ncs/v2.9.0/nrf/boards/shields/*/Kconfig.shield"
```

## build/power_hw_54l15/Kconfig/Kconfig.shield.defconfig
```kconfig
osource "/home/zengzhi/workspace/nordic/hw_test/power_hw_54l15/boards/shields/*/Kconfig.defconfig"
osource "/home/zengzhi/ncs/v2.9.0/nrf/boards/shields/*/Kconfig.defconfig"
```

## build/power_hw_54l15/Kconfig/boards/Kconfig.defconfig
```kconfig
# Load Zephyr board defconfig descriptions.
osource "/home/zengzhi/ncs/v2.9.0/zephyr/boards/nordic/nrf54l15dk/Kconfig.defconfig"
```
